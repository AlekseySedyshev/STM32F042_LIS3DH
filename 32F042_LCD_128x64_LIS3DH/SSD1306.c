#include "stm32f0xx.h" 
#include "stdbool.h"

#define 	LCD_Addr		0x78
#define   COMM    		0x80			//0b10000000
#define   DATE    		0xC0			//0b11000000
#define   BURST   		0x40			//0b01000000

const unsigned char init_lcd[]= 																										{
	0xA8,0x3F,										//0xA8 Set Multiplex Ratio
	0xD3,0x00,										//0xD3 Set Display Offset
	0x40,													//0x40 Set Display Start Line
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	0x14,													//Set Higher column
	0xAF													//Display ON
};
const unsigned char font[]= 																												{// Font 8*5 
 0x00, 0x00, 0x00, 0x00, 0x00 ,   // sp  32
 0x00, 0x00, 0x2f, 0x00, 0x00 ,   // !   33
 0x00, 0x07, 0x00, 0x07, 0x00 ,   // "   34
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 0x44, 0x64, 0x54, 0x4C, 0x44 ,   // z   122
  //
 0x00, 0x08, 0x36, 0x41, 0x00 ,   //7B- {
 0x00, 0x00, 0x7f, 0x00, 0x00 ,   //7C- |
 0x00, 0x41, 0x36, 0x08, 0x00 ,   //7D- }
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 0x58, 0x24, 0x24, 0x24, 0x7C  //  ?
 };





//------------------------------LCD ------------------------------

static bool WaitISRBitSet(uint32_t Bit)																							{
  uint32_t time_out=10000; 
  do
  {
    if((I2C1->ISR &( I2C_ISR_NACKF | I2C_ISR_ARLO | I2C_ISR_BERR)) || (time_out--==0))
    {
     I2C1->ICR = I2C_ICR_NACKCF | I2C_ICR_BERRCF | I2C_ICR_ARLOCF | I2C_ICR_ADDRCF;
		 I2C1->ISR |=1;//TXE 
			return false;
    }
  }
  while( !(I2C1->ISR & Bit) );
  return true;
}
void I2C_write(unsigned char byte_send)																			    		{//WRITE
	
		while(!(I2C1->ISR & WaitISRBitSet(I2C_ISR_TXE))){}; 
		I2C1->TXDR = byte_send;
		while(I2C1->ISR & I2C_ISR_TC){};
}
 
void I2C_Start(void)    																														{//Start
	  while(I2C1->ISR & I2C_ISR_BUSY){}; //I2C_ISR_BUSY
		I2C1->CR2 &=(~I2C_CR2_SADD) & (~I2C_CR2_RD_WRN)  & (~I2C_CR2_NACK);
	  I2C1->CR2 |= (LCD_Addr << I2C_CR2_SADD_Pos) | (0xFF<< I2C_CR2_NBYTES_Pos) | I2C_CR2_START;
		while((I2C1->ISR & I2C_ISR_TC)){}; 
	 }

void I2C_Stop(void) 																																{//Stop
	 while(I2C1->ISR & !WaitISRBitSet(I2C_ISR_TXE)){}; // TX buf Empty
	 I2C1->CR2 |= I2C_CR2_STOP;
	 while(!(I2C1->ISR & I2C_ISR_STOPF)){};
	 I2C1->ICR |= I2C_ICR_STOPCF;	
	 }
void CMD(unsigned char byte) 																												{
 I2C_write(COMM);
 I2C_write(byte);
 }
 
void LCD_Init(void) 																																{// INIT LCD T191
 I2C_Start();
CMD(0xAE);
for (unsigned char i=0;i<=sizeof(init_lcd);i++)
	{CMD(init_lcd[i]);}
I2C_Stop();
}

void LCD_Gotoxy ( unsigned char x, unsigned char y )														    {
       I2C_Start();
       
			 if (x>0xf) {CMD(0x10 |(x>>4));}
			 else {CMD(0x10);}
			 CMD(0x00 | (x&0xf));
			 CMD(0xb0 | y);  																							//Y - 0...7
       I2C_Stop();
    }
void LCD_mode(unsigned char mode)																										{ 
      
       I2C_Start();
       if(mode > 0)
       {CMD(0xA7);}
      else
       {CMD(0xA6);}
       I2C_Stop();
      }
void LCD_Char(char flash_o, unsigned char mode)															        {// Print Symbol
      	 unsigned char i,ch; 
         I2C_Start();
         I2C_write(BURST);
          for(i=0; i<5; i++)
      	  {
      	    ch = font[(flash_o - 32)*5+i];
      	     if(mode) { I2C_write(~ch); }
      			 else  	 { I2C_write(ch);}
      		 if(i == 4)
      			  {
      			    if(mode) { I2C_write(0xff); }
      				  else   {	 I2C_write(0x00); }
      			  }
      	   }
         I2C_Stop();
          }
void LCD_PrintStr(char *s, unsigned char mode)																	    {// Print String
          while (*s)
        {
          LCD_Char(*s, mode);
          s++;
        }
      }
void LCD_Clear(void)      																													{// Clear LCD
    	 unsigned char k, kk;
	for(kk=0;kk<8;kk++) 
	{
		I2C_Start();
		CMD(0x20);
		CMD(0x00);
		I2C_write(BURST);
		for(k=0;k<128;k++) I2C_write(0x00);	//LSB ??????, MSB ?????
		I2C_Stop();
	}
}       


void LCD_ClearStr(unsigned char y, unsigned char qnt )															{
unsigned char q,k;
	LCD_Gotoxy ( 0, y );
for (q=y;q<(qnt+y);q++){
		I2C_Start();
		CMD(0x20);
		CMD(0x00);
		CMD(0x10);
	  CMD(0xb0|q);
		I2C_write(BURST);
		for(k=0;k<128;k++) I2C_write(0x00);
		I2C_Stop();
}	
}
void LCD_PrintDec(long val,unsigned char mode) 																			{// Print Dec
	
	char i=1,d=0;
	unsigned char text[10];
//-------Added for support value less than '0' ----------------
	uint8_t minus_flag=0;
	uint32_t value;
	if (val>=0) {value=val;}
		else {value=val*(-1);minus_flag=1;}
//-------------------------------------------------	
	do 
  { 
    if (value >=10)  {
				d = value % 10; 																				
				text[i] = d + '0'; 																			
				value /= 10; 																						
			}
		else 
			{	text[i] = value + '0';
				value=0;
			}
 		i++;
  }
	while(value); 
//-------Added for support value less than '0'----------------
	if(minus_flag) {text[i]='-';}
	else {i--;}		
	
	do
	{	LCD_Char(text[i], mode);
		i--;
	}
	while(i);
}
			
void LCD_PrintHex(long val,unsigned char mode) 																			{// Print Hex
	
	char i=1,d=0;
	unsigned char text[10];
//-------------Added for support valur <0
	uint8_t minus_flag=0;
	uint32_t value;
	if (val>=0) {value=val;}
		else {value=val*(-1);minus_flag=1;}
//---------------------------------------		
	do 
  { 
    if (value >=0x10)  {
				d = value % 0x10; 																				
				if(d<0x0A) text[i] = d + '0'; 																			
				else 			 text[i] = d + 0x37;
				value /= 0x10; 																						
			}
		else 
			{	
				if(value < 0x0A)	text[i] = value + '0';			//0..9
				else 							text[i] = value + 0x37;			//A...F
				value=0;
			}
 		i++;
  }
	while(value); 
//-------Added for support valur <0----------------
	if(minus_flag) {text[i]='-';}
	else {i--;}		
//---------------------------------------		
	do
	{	LCD_Char(text[i], mode);
		i--;
	}
	while(i);
}

void LCD_PrintBin(unsigned char value,unsigned char mode) 													{// Print Bin
	
	unsigned char i=1,d=0;
	unsigned char text[8];
	do 
  { 
    if (value >=2)  {
				d = value % 2; 																				
				text[i] = d + '0'; 																			
				value /= 0x2; 																						
			}
		else 
			{	
				text[i] = value + '0';			//0..9
				value=0;
			}
 		i++;
  }
	while(i<9); 
	i--;			
	do
	{	LCD_Char(text[i], mode);
		i--;
	}
	while(i);
}	
	
void Flip_mode(unsigned char flip)																									{
I2C_Start();
if (flip>0) {CMD(0xA0);CMD(0xC0);}
else {CMD(0xA1);CMD(0xC8);}
I2C_Stop();
}
void slide_right(unsigned char start_page, unsigned char end_page, unsigned char interval)														{
I2C_Start();
CMD(0x26); CMD(0x00);
CMD(start_page);
CMD(interval);
CMD(end_page);
CMD(0x00);CMD(0xff);	
I2C_Stop();	
}
void slide_left(unsigned char start_page, unsigned char end_page, unsigned char interval)															{
I2C_Start();
CMD(0x27); CMD(0x00);
CMD(start_page);
CMD(interval);
CMD(end_page);
CMD(0x00);CMD(0xff);	
I2C_Stop();	
}
void stop_slide(void)																																{
I2C_Start();
CMD(0x2E); 
I2C_Stop();	
}
void start_slide(void)																															{
I2C_Start();
CMD(0x2F); 
I2C_Stop();	
}

void scroll_vright(unsigned char start_page, unsigned char end_page, unsigned char interval,unsigned char v_offset)		{
I2C_Start();
CMD(0x29); CMD(0x00);
CMD(start_page & 0x07);
CMD(interval & 0x07);
CMD(end_page & 0x07);
CMD(v_offset & 0x3f);
	
I2C_Stop();	
}
void scroll_vleft(unsigned char start_page, unsigned char end_page, unsigned char interval,unsigned char v_offset)		{
I2C_Start();
CMD(0x2A); CMD(0x00);
CMD(start_page & 0x07);
CMD(interval & 0x07);
CMD(end_page & 0x07);
CMD(v_offset & 0x3f);	
I2C_Stop();	
}
void scroll_area(unsigned char start_page, unsigned char end_page)									{
I2C_Start();
CMD(0xA3); 
CMD(start_page & 0x3f);
CMD(end_page & 0x7f);
I2C_Stop();	
}
